## CMakeLists.txt
```
# SPDX-License-Identifier: Apache-2.0

cmake_minimum_required(VERSION 3.13.1)
include($ENV{ZEPHYR_BASE}/cmake/app/boilerplate.cmake NO_POLICY_SCOPE)
project(button)

target_sources(app PRIVATE src/main.c src/expanderpwm.c src/expander.c src/i2c_adapter.c)
```

## sample.yaml
```
sample:
  name: Teamlights
tests:
  sample.button:
    tags: button gpio
    filter: DT_GPIO_KEYS_SW0_GPIOS_CONTROLLER
    depends_on: gpio
    harness: button
```

## prj.conf
```kconfig
CONFIG_GPIO=y
CONFIG_PINMUX=y
CONFIG_I2C=y
CONFIG_STDOUT_CONSOLE=y
CONFIG_PRINTK=y
```

## src/main.c
```c
/*
 * Copyright (c) 2016 Open-RnD Sp. z o.o.
 *
 * SPDX-License-Identifier: Apache-2.0
 */

/******************************************************************************
//std
******************************************************************************/
#include <stdbool.h>
#include <inttypes.h>

#include <zephyr.h>
#include <device.h>
#include <drivers/gpio.h>
#include <sys/printk.h>
#include <drivers/pinmux.h>
#include <fsl_port.h>
#include "expander.h"
#include "expanderpwm.h"

void fade()
{
	for(uint32_t pwm = 0; pwm<=0xff; pwm++)
	{
		for(uint32_t cnt = 0; cnt<0xff; cnt++)
		{
			if(cnt == 0)
				ExpanderWriteGPIOAB(EXPANDER_A, 0x0);
			if(pwm == cnt)
				ExpanderWriteGPIOAB(EXPANDER_A, 0xffff);
			k_busy_wait(10);
		}
		k_busy_wait(500);
	}

	//k_busy_wait(1000000);

	for(uint32_t pwm = 0; pwm<=0xff; pwm++)
	{
		for(uint32_t cnt = 0; cnt<0xff; cnt++)
		{
			if(cnt == 0)
				ExpanderWriteGPIOAB(EXPANDER_A, 0xffff);
			if(pwm == cnt)
				ExpanderWriteGPIOAB(EXPANDER_A, 0x0);
			k_busy_wait(10);
		}
		k_busy_wait(500);
	}

	k_busy_wait(1000000);
}

void main(void)
{

	struct device *porta =
		device_get_binding("porta");

	struct device *portb =
		device_get_binding("portb");

	struct device *portc =
		device_get_binding("portc");

	pinmux_pin_set(portb, 23, PORT_PCR_MUX(kPORT_MuxAsGpio));
	pinmux_pin_set(porta, 2, PORT_PCR_MUX(kPORT_MuxAsGpio));
	
	//reset expander
	pinmux_pin_set(portc, 16, PORT_PCR_MUX(kPORT_MuxAsGpio));
	struct device *gpioc;
	gpioc = device_get_binding("GPIO_2");
	gpio_pin_configure(gpioc, 16, GPIO_DIR_OUT);
	//active low
	gpio_pin_write(gpioc, 16, 0);
	gpio_pin_write(gpioc, 16, 1);

	expander_pwm_t pwm = {EXPANDER_A};
	ExpanderPWMInit(&pwm);
	ExpanderPWMSet(&pwm, 8, 0);
	ExpanderPWMSetFadeRate(&pwm, 8, 10, 10);

	ExpanderPWMSet(&pwm, 9, 0);
	ExpanderPWMSetFadeRate(&pwm, 9, 20, 20);

	ExpanderPWMSet(&pwm, 10, 0);
	ExpanderPWMSetFadeRate(&pwm, 10, 30, 30);

	while (1) 
	{
		static bool on = false;
		static uint16_t counter = 0;

		if(0==counter)
		{
			if(on)
				ExpanderPWMSet(&pwm, 8, 0);
			else
				ExpanderPWMSet(&pwm, 8, 0xff);
		}
		else if(20000 == counter)
		{
			if(on)
				ExpanderPWMSet(&pwm, 9, 0);
			else
				ExpanderPWMSet(&pwm, 9, 0xff);
		}
		else if(40000 == counter)
		{
			if(on)
				ExpanderPWMSet(&pwm, 10, 0);
			else
				ExpanderPWMSet(&pwm, 10, 0xff);

			on = !on;
		}

		counter++;

		ExpanderPWMUpdate(&pwm);
	}
}
```

## src/defines.h
```c
/******************************************************************************
        team lights
        File: defines.h
        Author: Ben Olayinka
        Date: 25 Jun 2019
        Brief:
******************************************************************************/
#ifndef TEAMLIGHTS_DEFINES_H
#define TEAMLIGHTS_DEFINES_H

//function macros
#define bitRead(value, bit) (((value) >> (bit)) & 0x01)
#define bitSet(value, bit) ((value) |= (1UL << (bit)))
#define bitClear(value, bit) ((value) &= ~(1UL << (bit)))
#define bitWrite(value, bit, bitvalue) (bitvalue ? bitSet(value, bit) : bitClear(value, bit))

#ifndef max
#define max(a, b)  (((a) > (b)) ? (a) : (b))
#endif

#ifndef min
#define min(a, b)  (((a) < (b)) ? (a) : (b))
#endif

#endif // TEAMLIGHTS_DEFINES_H
```

## src/expander.c
```c
/******************************************************************************
        Teenage Engineering oplab_baremetal_usb_lite
        File: expander.c
        Author: Ben Olayinka
        Date: 12 Jul 2019
        Brief: MCP23017 driver
******************************************************************************/

/******************************************************************************
//std
******************************************************************************/
#include <stdbool.h>
#include <inttypes.h>

/******************************************************************************
//local
******************************************************************************/
#include "expander.h"
#include "i2c_adapter.h"
#include "defines.h"

/******************************************************************************
//defines
******************************************************************************/

// registers
#define EXPANDER_IODIRA 0x00
#define EXPANDER_IPOLA 0x02
#define EXPANDER_GPINTENA 0x04
#define EXPANDER_DEFVALA 0x06
#define EXPANDER_INTCONA 0x08
#define EXPANDER_IOCONA 0x0A
#define EXPANDER_GPPUA 0x0C
#define EXPANDER_INTFA 0x0E
#define EXPANDER_INTCAPA 0x10
#define EXPANDER_GPIOA 0x12
#define EXPANDER_OLATA 0x14

#define EXPANDER_IODIRB 0x01
#define EXPANDER_IPOLB 0x03
#define EXPANDER_GPINTENB 0x05
#define EXPANDER_DEFVALB 0x07
#define EXPANDER_INTCONB 0x09
#define EXPANDER_IOCONB 0x0B
#define EXPANDER_GPPUB 0x0D
#define EXPANDER_INTFB 0x0F
#define EXPANDER_INTCAPB 0x11
#define EXPANDER_GPIOB 0x13
#define EXPANDER_OLATB 0x15

#define EXPANDER_INT_ERR 255

/******************************************************************************
//prototypes
******************************************************************************/

typedef struct _expander_t
{
	const expander_id_t expanderId;
	const uint8_t i2cAddress;
	bool isInitialized;
} expander_t;

static expander_t expanders[NUM_EXPANDERS] =
{
		//id, i2caddress, isInit
		{EXPANDER_A, 0b0100000U, false},
		{EXPANDER_B, 0b0100001U, false},
};

/******************************************************************************
//functions
******************************************************************************/

static inline void writeRegister(expander_id_t expanderId, uint8_t reg, uint8_t data)
{
	I2CWriteRegister(expanders[expanderId].i2cAddress, reg, data);
}

static inline uint8_t readRegister(expander_id_t expanderId, uint8_t reg)
{
	uint8_t temp;
	I2CReadRegister(expanders[expanderId].i2cAddress, reg, &temp);
	return temp;
}

static uint8_t getBitFromPin(uint8_t pin)
{
	return pin % 8;
}

uint8_t getRegFromPin(uint8_t pin, uint8_t portA, uint8_t portB)
{
	if(pin < 8)
	{
		return portA;
	}
	else
	{
		return portB;
	}
}

static void updateRegisterBit(expander_id_t expanderId, uint8_t pin, uint8_t val, uint8_t portA, uint8_t portB)
{
	uint8_t reg_val;
	uint8_t reg_addr = getRegFromPin(pin, portA, portB);
	uint8_t bit = getBitFromPin(pin);
	reg_val = readRegister(expanderId, reg_addr);

	bitWrite(reg_val, bit, val);

	writeRegister( expanderId, reg_addr, reg_val);
}

void ExpanderInit(expander_id_t expanderId)
{
	I2CInit();
	writeRegister( expanderId, EXPANDER_IODIRA, 0xff);
	writeRegister( expanderId, EXPANDER_IODIRB, 0xff);
}

void ExpanderPinMode(expander_id_t expanderId, uint8_t pin, uint8_t direction)
{
	updateRegisterBit(expanderId, pin, (direction==INPUT), EXPANDER_IODIRA, EXPANDER_IODIRB);
}

void ExpanderPinInvertInput(expander_id_t expanderId, uint8_t pin, uint8_t invert)
{
	updateRegisterBit(expanderId, pin, invert, EXPANDER_IPOLA, EXPANDER_IPOLB);
}

uint16_t ExpanderReadGPIOAB(expander_id_t expanderId)
{
	uint16_t ba = 0;
	uint8_t a;

	a = readRegister(expanderId, EXPANDER_GPIOA);
	ba = readRegister(expanderId, EXPANDER_GPIOB);

	ba <<= 8;
	ba |= a;
	return ba;
}

uint8_t ExpanderReadGPIOA(expander_id_t expanderId)
{
	uint8_t a;
	a = readRegister(expanderId, EXPANDER_GPIOA);
	return a;
}

uint8_t ExpanderReadGPIOB(expander_id_t expanderId)
{
	uint8_t b;
	b = readRegister(expanderId, EXPANDER_GPIOA);
	return b;
}

void ExpanderWriteGPIOAB(expander_id_t expanderId, uint16_t ba)
{
	writeRegister( expanderId, EXPANDER_GPIOA, (uint8_t)(ba & 0xff));
	writeRegister( expanderId, EXPANDER_GPIOB, (uint8_t)(ba >> 8 & 0xff));
}

void ExpanderWritePin(expander_id_t expanderId, uint8_t pin, uint8_t state)
{
	uint8_t gpio;
	uint8_t bit = getBitFromPin(pin);

	uint8_t reg_addr = getRegFromPin(pin, EXPANDER_OLATA, EXPANDER_OLATB);
	gpio = readRegister(expanderId, reg_addr);

	bitWrite(gpio, bit, state);

	reg_addr = getRegFromPin(pin, EXPANDER_GPIOA, EXPANDER_GPIOB);
	writeRegister( expanderId, reg_addr, gpio);
}

uint8_t ExpanderReadPin(expander_id_t expanderId, uint8_t pin)
{
	uint8_t bit = getBitFromPin(pin);
	uint8_t reg_addr = getRegFromPin(pin, EXPANDER_GPIOA, EXPANDER_GPIOB);
	return (readRegister(expanderId, reg_addr) >> bit) & 0x1;
}

void ExpanderSetPullup(expander_id_t expanderId, uint8_t pin, uint8_t state)
{
	updateRegisterBit(expanderId, pin, state, EXPANDER_GPPUA, EXPANDER_GPPUB);
}

//set mirror to OR interrupts, polarity sets value of interrupt hi or lo
void ExpanderSetupInterrupts(expander_id_t expanderId, uint8_t mirroring, uint8_t openDrain, uint8_t polarity)
{
	//port a
	uint8_t conf = readRegister(expanderId, EXPANDER_IOCONA);
	bitWrite(conf, 6, mirroring);
	bitWrite(conf, 2, openDrain);
	bitWrite(conf, 1, polarity);
	writeRegister(expanderId, EXPANDER_IOCONA, conf);

	//port b
	conf = readRegister(expanderId, EXPANDER_IOCONB);
	bitWrite(conf, 6, mirroring);
	bitWrite(conf, 2, openDrain);
	bitWrite(conf, 1, polarity);
	writeRegister(expanderId, EXPANDER_IOCONB, conf);
}

void ExpanderSetupInterruptPin(expander_id_t expanderId, uint8_t pin, uint8_t mode)
{
	//interrupt compare or change
	updateRegisterBit(expanderId, pin, (mode!=INTERRUPT_CHANGE), EXPANDER_INTCONA, EXPANDER_INTCONB);
	//interrupt rising or falling
	updateRegisterBit(expanderId, pin, (mode==INTERRUPT_FALLING), EXPANDER_DEFVALA, EXPANDER_DEFVALA);
	//enable interrupts
	updateRegisterBit(expanderId, pin, 1, EXPANDER_GPINTENA, EXPANDER_GPINTENB);
}

uint8_t ExpanderGetLastInterruptPin(expander_id_t expanderId)
{
	uint8_t intf;

	intf = readRegister(expanderId, EXPANDER_INTFA);
	for(uint8_t bit = 0; bit < 8; bit ++)
	{
		if (bitRead(intf, bit))
		{
			return bit;
		}
	}

	intf = readRegister(expanderId, EXPANDER_INTFB);
	for(uint8_t bit = 0; bit < 8; bit ++)
	{
		if (bitRead(intf, bit))
		{
			return bit;
		}
	}
	return EXPANDER_INT_ERR;
}

uint8_t ExpanderGetLastInterruptPinValue(expander_id_t expanderId)
{
	uint8_t pin = ExpanderGetLastInterruptPin(expanderId);
	if(EXPANDER_INT_ERR != pin)
	{
		uint8_t cap_reg = getRegFromPin(pin, EXPANDER_INTCAPA, EXPANDER_INTCAPB);
		uint8_t bit = getBitFromPin(pin);
		uint8_t reg_val;
		reg_val = readRegister(expanderId, cap_reg);
		return((reg_val >> bit) & (0x01));
	}
	return EXPANDER_INT_ERR;
}

/* end of file */
```

## src/expander.h
```c
/******************************************************************************
        Teenage Engineering oplab_baremetal_usb_lite
        File: expander.h
        Author: Ben Olayinka
        Date: 12 Jul 2019
        Brief: MCP23017 driver
******************************************************************************/
#ifndef EXPANDER_EXPANDER_H_
#define EXPANDER_EXPANDER_H_

/******************************************************************************
//std
******************************************************************************/
#include <stdbool.h>
#include <inttypes.h>

#define LOW 0x0
#define HIGH 0x1

#define INPUT 0x0
#define OUTPUT 0x1

typedef enum {
	INTERRUPT_NONE,
	INTERRUPT_CHANGE = 0x1,
	INTERRUPT_FALLING = 0x2,
	INTERRUPT_RISING = 0x3
} interrupt_t;

typedef enum {
	EXPANDER_A,
	EXPANDER_B,
	NUM_EXPANDERS
} expander_id_t;

void ExpanderInit(expander_id_t expanderId);

void ExpanderPinMode(expander_id_t expanderId, uint8_t pin, uint8_t direction);

void ExpanderPinInvertInput(expander_id_t expanderId, uint8_t pin, uint8_t invert);

uint16_t ExpanderReadGPIOAB(expander_id_t expanderId);

uint8_t ExpanderReadGPIOA(expander_id_t expanderId);

uint8_t ExpanderReadGPIOB(expander_id_t expanderId);

void ExpanderWriteGPIOAB(expander_id_t expanderId, uint16_t ba);

void ExpanderWritePin(expander_id_t expanderId, uint8_t pin, uint8_t state);

uint8_t ExpanderReadPin(expander_id_t expanderId, uint8_t pin);

void ExpanderSetPullup(expander_id_t expanderId, uint8_t pin, uint8_t state);

//set mirror to OR interrupts, polarity sets value of interrupt hi or lo
void ExpanderSetupInterrupts(expander_id_t expanderId, uint8_t mirroring, uint8_t openDrain, uint8_t polarity);

void ExpanderSetupInterruptPin(expander_id_t expanderId, uint8_t pin, uint8_t mode);

uint8_t ExpanderGetLastInterruptPin(expander_id_t expanderId);

uint8_t ExpanderGetLastInterruptPinValue(expander_id_t expanderId);

#endif /* EXPANDER_EXPANDER_H_ */
/* end of file */
```

## src/expanderpwm.c
```c
/******************************************************************************
//std
******************************************************************************/
#include <stdbool.h>
#include <inttypes.h>
#include "defines.h"

#include "expanderpwm.h"
#include "expander.h"

uint8_t soft_count = 0xff;

void ExpanderPWMUpdate(expander_pwm_t *expander)
{
	soft_count++;

	if(soft_count == 0)
	{
		for(uint8_t cnl = 0; cnl < EXPANDER_PWM_CHANNELS_MAX; cnl++)
		{
			expander_pwm_channel *channel = &expander->pwmChannels[cnl];

			if(channel->isPWM)
			{
				//if fade value set
				if(channel->fadeUpRate || channel->fadeDownRate)
				{
					int16_t direction = channel->pwmGoal - channel->pwmCurrent;
					int16_t goal = channel->pwmGoal;

					if(direction > 0 && channel->fadeUpRate > 0)
					{
						goal = channel->pwmCurrent + channel->fadeUpRate;
						if(goal > channel->pwmGoal)
						  goal = channel->pwmGoal;
					}
					else if(direction < 0 && channel->fadeDownRate > 0)
					{
						goal = channel->pwmCurrent - channel->fadeDownRate;
						if(goal < channel->pwmGoal)
						  goal = channel->pwmGoal;
					}
					channel->pwmCurrent = goal; 
				}
				//no fade value
				else
				{
					channel->pwmCurrent = channel->pwmGoal;
				}

				if(channel->pwmCurrent)
				{
					ExpanderLedOnInternal(expander, cnl);
				}
			}
		}
	}

	for(uint8_t cnl = 0; cnl < EXPANDER_PWM_CHANNELS_MAX; cnl++)
	{
		expander_pwm_channel *channel = &expander->pwmChannels[cnl];

		if(channel->isPWM)
		{
			expander_pwm_channel *channel = &expander->pwmChannels[cnl];
			if(channel->pwmCurrent != 0xff && channel->pwmCurrent == soft_count)
			{
				ExpanderLedOffInternal(expander, cnl);
			}
		}
	}

	if(expander->ledsDirty)
	{
		ExpanderWriteGPIOAB(expander->expanderId, expander->ledsGPIOState);
	}
}

void ExpanderPWMInit(expander_pwm_t *expander)
{
	ExpanderInit(expander->expanderId);

	for(uint8_t cnl = 0; cnl < EXPANDER_PWM_CHANNELS_MAX; cnl++)
	{
		expander_pwm_channel *channel = &expander->pwmChannels[cnl];
		channel->isPWM = false;
		channel->pin = cnl;
		channel->polarity = POLARITY_DEFAULT;
		channel->pwmGoal = 0;
		channel->pwmCurrent = 0;
		channel->fadeDownRate = 0;
		channel->fadeUpRate = 0;
		ExpanderLedOffInternal(expander, cnl);
	}
}

static void ExpanderPWMLedInit(expander_pwm_t *expander, uint16_t pin)
{
	ExpanderPinMode(expander->expanderId, pin, OUTPUT);
}

void ExpanderPWMSet(expander_pwm_t *expander, uint16_t pin, uint8_t val)
{
	expander_pwm_channel *channel = &expander->pwmChannels[pin];

	channel->isPWM = true;
	channel->pin = pin;
	channel->polarity = POLARITY_DEFAULT;
	channel->pwmGoal = val;
	ExpanderPWMLedInit(expander, pin);
	ExpanderLedOffInternal(expander, pin);
}

void ExpanderPWMSetFadeRate(expander_pwm_t *expander, uint16_t pin, uint8_t fadeUpRate, uint8_t fadeDownRate)
{
	expander_pwm_channel *channel = &expander->pwmChannels[pin];

	channel->isPWM = true;

	if(fadeUpRate > 0)
	{
		channel->fadeUpRate = fadeUpRate;
	}

	if(fadeDownRate > 0)
	{
		channel->fadeDownRate = fadeDownRate;
	}
}

void ExpanderLedOnInternal(expander_pwm_t *expander, uint16_t pin)
{
	uint8_t on_pol = !expander->pwmChannels[pin].polarity;
	bitWrite(expander->ledsGPIOState, pin, on_pol);
	expander->ledsDirty = true;
}

void ExpanderLedOffInternal(expander_pwm_t *expander, uint16_t pin)
{
	uint8_t off_pol = expander->pwmChannels[pin].polarity;
	bitWrite(expander->ledsGPIOState, pin, off_pol);
	expander->ledsDirty = true;
}
```

## src/expanderpwm.h
```c
#ifndef EXPANDER_PWM_H_
#define EXPANDER_PWM_H_

#define EXPANDER_PWM_CHANNELS_MAX 16
#define POLARITY_NON_INVERTED 0
#define POLARITY_INVERTED 1
#define POLARITY_DEFAULT POLARITY_INVERTED

/******************************************************************************
//std
******************************************************************************/
#include <stdbool.h>
#include <inttypes.h>

#include "expander.h"

typedef struct
{
  // hardware I/O port and pin for this channel
	bool isPWM; 
  int8_t pin;
  uint8_t polarity;
  uint8_t pwmGoal;
  uint8_t pwmCurrent;
  uint8_t fadeUpRate;
  uint8_t fadeDownRate;
} expander_pwm_channel;

typedef struct
{
	expander_id_t expanderId;
	uint16_t ledsGPIOState;
	bool ledsDirty;
	expander_pwm_channel pwmChannels[EXPANDER_PWM_CHANNELS_MAX];
} expander_pwm_t;

void ExpanderPWMUpdate(expander_pwm_t *expander);

void ExpanderPWMInit(expander_pwm_t *expander);

void ExpanderPWMSet(expander_pwm_t *expander, uint16_t pin, uint8_t val);

void ExpanderLedOnInternal(expander_pwm_t *expander, uint16_t pin);

void ExpanderLedOffInternal(expander_pwm_t *expander, uint16_t pin);


#endif
```

## src/i2c_adapter.c
```c
/******************************************************************************
        Teenage Engineering oplab_baremetal_usb_lite
        File: i2c.c
        Author: Ben Olayinka
        Date: 11 Jun 2019
        Brief:
******************************************************************************/

/******************************************************************************
//std
******************************************************************************/
#include <stdbool.h>
#include <inttypes.h>
#include <sys/printk.h>

/******************************************************************************
//zephyr
******************************************************************************/
#include "i2c.h"

/******************************************************************************
//variables
******************************************************************************/
struct device *i2c_dev;
static bool is_initialized = false;

/******************************************************************************
//functions
******************************************************************************/
void I2CInit()
{
	i2c_dev = device_get_binding("I2C_0");
	i2c_configure(i2c_dev, I2C_MODE_MASTER | I2C_SPEED_SET(I2C_SPEED_FAST));
}

void I2CDeinit()
{
}

void I2CReadRegister(const uint8_t slave_addr, const uint8_t reg, uint8_t *data)
{
	i2c_reg_read_byte(i2c_dev, slave_addr,
				    reg, data);
}

void I2CWriteRegister(const uint8_t slave_addr, const uint8_t reg, const uint8_t data)
{
	i2c_reg_write_byte(i2c_dev, slave_addr,
				    reg, data);
}

void I2CWriteBytes(const uint8_t slave_addr, const uint8_t *data, uint32_t length)
{
	i2c_write(i2c_dev, data, 1, slave_addr);
}

/* end of file */
```

## src/i2c_adapter.h
```c
/******************************************************************************
        Teenage Engineering oplab_baremetal_usb_lite
        File: i2c.h
        Author: Ben Olayinka
        Date: 12 Jun 2019
        Brief:
******************************************************************************/
#ifndef I2C_I2C_H_
#define I2C_I2C_H_

/******************************************************************************
//std
******************************************************************************/
#include <stdbool.h>
#include <inttypes.h>

void I2CInit();
void I2CDeinit();
void I2CReadRegister(const uint8_t slave_addr, const uint8_t reg, uint8_t *data);
void I2CWriteRegister(const uint8_t slave_addr, const uint8_t reg, uint8_t data);
void I2CWriteBytes(const uint8_t slave_addr, const uint8_t *data, uint32_t length);

#endif /* I2C_I2C_H_ */
/* end of file */
```
